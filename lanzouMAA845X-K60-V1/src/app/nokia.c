
#include "common.h"
#include "include.h"


/************************************************************************
     NOKIA5110 一行可以显示14个字符，可以显示六行。
************************************************************************/
/*-----------------------------------------------------------------------
font5x8【】        : 数据表
编写日期          ：2012-11-01 
最后修改日期      ：2012-11-01  
-----------------------------------------------------------------------*/

const u8 font5x8[]={          
0x00, 0x00, 0x00, 0x00, 0x00,   // sp    1
0x00, 0x00, 0x2f, 0x00, 0x00,   // !     2
0x00, 0x07, 0x00, 0x07, 0x00,   // "     3
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0x08, 0x10, 0x08, 0x04, 0x08    // ~     95
}; 
const u8 write_chinese[][24]={
  0x00,0xFC,0x94,0x94,0x94,0xFF,0x94,0x94,0x94,0xFE,0x04,0x00,0x00,0x01,0x00,0x00,0x00,0x03,0x04,0x04,0x04,0x04,0x06,0x00,   //电
};
/*-----------------------------------------------------------------------
delay_1us         : 延时程序
编写日期          ：2012-11-01 
最后修改日期      ：2012-11-01  
-----------------------------------------------------------------------*/

void delay_1us(void)                 //1.28us延时函数
  {
   volatile u16 i;
  for(i=0;i<15;i++) ;

  }
/*-----------------------------------------------------------------------
delay_1ns         : 延时程序
编写日期          ：2012-11-01 
最后修改日期      ：2012-11-01  
-----------------------------------------------------------------------*/

void delay_1ns(void)                 //500ns延时函数
  {
   volatile u16 i;
   
  for(i=0;i<15;i++) ;

  
  }
/*-----------------------------------------------------------------------
LCD_clear         : LCD清屏函数
编写日期          ：2012-11-01 
最后修改日期      ：2012-11-01  
-----------------------------------------------------------------------*/
void LCD_clear(void)
  {
    unsigned int i;

    LCD_write_byte(0x0c, 0);			
    LCD_write_byte(0x80, 0);			

    for (i=0; i<504; i++)
      LCD_write_byte(0, 1);			
  }

/*********************************************************** 
函数名称：LCD_write_byte
函数功能：模拟SPI接口时序写数据/命令LCD
入口参数：data    ：写入的数据；
          command ：写数据/命令选择；
出口参数：无 
备 注： 
***********************************************************/
void LCD_write_byte(u8 dat, u8 command)
  {
    u8 i;
    LCD_CE = 0;					  //5110片选有效，允许输入数据
    if (command == 0)				 //写命令
          LCD_DC = 0;				  
    else  LCD_DC = 1;			  //写数据
	for(i=0;i<8;i++)				     //传送8bit数据
		{ 
                        if(dat&0x80)
			   SDIN = 1;
			else
			   SDIN = 0;
			SCLK = 0;
			dat = dat << 1;
                        delay_1ns();
                    //    DELAY_MS(1) ;
			SCLK = 1; 
                    //    DELAY_MS(1) ;
                        delay_1ns();
}
     LCD_CE = 1;					  //禁止5110
  }
/*********************************************************** 
函数名称：LCD_init
函数功能：5110初始化
入口参数：无
出口参数：无 
备 注： 
***********************************************************/
void LCD_init(void)
  {
   LCD_RST = 0;     // 产生一个让LCD复位的低电平脉冲
    delay_1us();
 //  DELAY_MS(1) ;
   LCD_RST = 1;

   LCD_CE = 0;     // 关闭LCD
    delay_1us();
 //  DELAY_MS(1) ;
   LCD_CE = 1;     // 使能LCD
    delay_1us();
 //  DELAY_MS(1) ;

    LCD_write_byte(0x21, 0);	// 使用扩展命令设置LCD模式
    LCD_write_byte(0xc8, 0);	// 设置液晶偏置电压
    LCD_write_byte(0x06, 0);	// 温度校正
    LCD_write_byte(0x13, 0);	// 1:48
    LCD_write_byte(0x20, 0);	// 使用基本命令，V=0，水平寻址
    LCD_clear();	           // 清屏
    LCD_write_byte(0x0c, 0);	// 设定显示模式，正常显示
   
    LCD_CE = 0;      // 关闭LCD
  }
/*********************************************************** 
函数名称：LCD_set_XY
函数功能：设置LCD坐标函数
入口参数：X       ：0－83
          Y       ：0－5
出口参数：无 
备 注： 
***********************************************************/
void LCD_set_XY(u8 X, u8 Y)
  {
    LCD_write_byte(0x40 | Y, 0);	// column
    LCD_write_byte(0x80 | X, 0);        // row
  }
/*********************************************************** 
函数名称：LCD_write_char
函数功能：显示英文字符
入口参数：c	:  显示的字符
出口参数：无 
备 注： 
***********************************************************/
void LCD_write_char(u8 c)
{
    u8 line;
    u16 cout ;
    cout =  c ;
    if((cout < 32)||((cout > 126)))
         cout = 0;
    
    cout -= 32;                       //数组的行号
    cout = cout*5 ;

    for (line=0; line<5; line++)
    {
      LCD_write_byte(font5x8[cout], 1);
      cout ++ ;
    }
    LCD_write_byte(0, 1);
}
/*-----------------------------------------------------------------------
LCD_write_english_String  : 英文字符串显示函数

输入参数：*s      ：英文字符串指针；
          X、Y    : 显示字符串的位置,x 0-83 ,y 0-5

编写日期          ：2004-8-10 
最后修改日期      ：2004-8-10 		
-----------------------------------------------------------------------*/
void LCD_write_english_string(u8 X, u8 Y, u8 *s)   //u8 是 unsigned char u16 是 unsigned short  u32 是 unsigned int
  {
    LCD_set_XY(X,Y);
    while (*s) 
      {
	 LCD_write_char(*s);
	 s++;
      }
  }
/*-----------------------------------------------------------------------
LCD_write_chinese_string: 在LCD上显示汉字

输入参数：X、Y    ：显示汉字的起始X、Y坐标；
          ch_with ：汉字点阵的宽度
          num     ：显示汉字的个数；  
          line    ：汉字点阵数组中的起始行数
          row     ：汉字显示的行间距
编写日期          ：2004-8-11 
最后修改日期      ：2004-8-12 
测试：
	LCD_write_chi(0,0,12,7,0,0);
	LCD_write_chi(0,2,12,7,0,0);
	LCD_write_chi(0,4,12,7,0,0);	
-----------------------------------------------------------------------*/                        
void LCD_write_chinese_string(u8 X, u8 Y, u8 ch_with,u8 num, u8 line, u8 row)
  {
    u8 i,n;
    
    LCD_set_XY(X,Y);                             //设置初始位置
    
    for (i=0;i<num;)
      {
      	for (n=0; n<ch_with*2; n++)              //写一个汉字
      	  { 
      	    if (n==ch_with)                      //写汉字的下半部分
      	      {
      	        if (i==0) LCD_set_XY(X,Y+1);
      	        else
      	           LCD_set_XY((X+(ch_with+row)*i),Y+1);
              }
      	    LCD_write_byte(write_chinese[line+i][n],1);
      	  }
      	i++;
      	LCD_set_XY((X+(ch_with+row)*i),Y);
      }
  }
  


/*-----------------------------------------------------------------------
LCD_draw_map      : 位图绘制函数

输入参数：X、Y    ：位图绘制的起始X、Y坐标；
          *map    ：位图点阵数据；
          Pix_x   ：位图像素（长）
          Pix_y   ：位图像素（宽）

编写日期          ：2004-8-13
最后修改日期      ：2004-8-13 
-----------------------------------------------------------------------*/
void LCD_draw_bmp_pixel(u8 X,u8 Y,u8 *map,u8 Pix_x,u8 Pix_y)
  {
    u32 i,n;
    u8 row;
    
    if (Pix_y%8==0) row=Pix_y/8;      //计算位图所占行数
      else
        row=Pix_y/8+1;
    
    for (n=0;n<row;n++)
      {
      	LCD_set_XY(X,Y);
        for(i=0; i<Pix_x; i++)
          {
            LCD_write_byte(map[i+n*Pix_x], 1);
          }
        Y++;                         //换行
      }      
  }


